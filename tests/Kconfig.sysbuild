## tests/Kconfig.sysbuild
```kconfig
#
# Copyright 2025-2026 NXP
#
# SPDX-License-Identifier: BSD-3-Clause

config dsp_board
    string
    default "$(board)"

config dsp_toolchain
    string
    default "xtensa"

config secondary_board
    string
    default "$(board)_nbu" if ($(board) = "kw43evk" || $(board) = "frdmkw43")
    default "$(board)"

config secondary_toolchain
    string
    default "$(toolchain)"

# This is for internal board support
osource "${SdkRootDirPath}/${board_root}/${board}/Kconfig.sysbuild"

# This is for external custom board support
osource "${CUSTOM_BOARD_ROOT}/${board}/Kconfig.sysbuild"
```
